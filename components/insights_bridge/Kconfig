## components/insights_bridge/Kconfig
```kconfig
menu "GeoLocator ESP Insights bridge"

config APP_ESP_INSIGHTS_TEST_AUTH_PROVIDER
    bool "Use the deterministic test auth provider"
    depends on APP_ESP_INSIGHTS
    default n
    help
        Build a non-secret auth provider for the opt-in compile/link profile.
        This value is only a test fixture and must never be used as a
        production credential.

endmenu
```

## components/main_barometer/Kconfig
```kconfig
config MAIN_BAROMETER_BMP280_ADDRESS
    hex "Preferred MAIN BMP280 I2C address"
    range 0x76 0x77
    default 0x77
    help
        The driver probes both 0x76 and 0x77 and tries this address first.
```

## components/nrf_topology_service/Kconfig
```kconfig
menu "nRF log collector"

config NRF_LOG_POLL_NODE_BUDGET_MS
    int "Deadline for one node visit, including mux close (ms)"
    range 120 1000
    default 120
    help
        Includes selection, a bounded request/reply, mux close and one scheduler
        tick. Work stops between pairs and resumes from the saved protocol phase.
        The 150 ms bus-owner guard remains independent of this visit budget.

config NRF_LOG_POLL_ITERATION_BUDGET_MS
    int "Deadline for one log polling slice (ms)"
    range 120 2000
    default 120
    help
        Every pair, including the first STATUS or BLOCK, must fit. Remaining
        nodes and protocol progress resume in a later slice. Urgent work stops
        collection at the next safe pair boundary. Driver timeouts are bounded
        by the remaining deadline; task preemption can still delay scheduling.

config NRF_LOG_POLL_PERIOD_MS
    int "Interval between log polling rounds (ms)"
    range 100 60000
    default 1000

config NRF_LOG_POLL_BACKOFF_MAX_ROUNDS
    int "Maximum backoff after a log transport or protocol fault (rounds)"
    range 1 255
    default 32

endmenu
```

## components/pb2_uart_bridge/Kconfig
```kconfig
menu "PocketBeagle 2 UART Bridge (Phase 2)"

    config PB2_UART_BRIDGE_ENABLE
        bool "Enable PocketBeagle 2 UART bridge (disabled until physical DevKit revision verified)"
        default n
        help
            Enable non-blocking UART preview/status bridge to PocketBeagle 2 A0.
            Keep disabled until ESP32-S3 DevKitC board revision (v1.0 vs v1.1) and
            electrical backfeed protection are physically verified.

    choice PB2_UART_DEVKIT_PROFILE
        prompt "ESP32-S3 DevKitC UART pin profile"
        depends on PB2_UART_BRIDGE_ENABLE
        default PB2_UART_PROFILE_DEVKITC_V1_1

        config PB2_UART_PROFILE_DEVKITC_V1_0
            bool "DevKitC v1.0 (TX=GPIO7, RX=GPIO38)"

        config PB2_UART_PROFILE_DEVKITC_V1_1
            bool "DevKitC v1.1 (TX=GPIO7, RX=GPIO48)"
    endchoice

    config PB2_UART_BAUD_RATE
        int "UART baud rate"
        depends on PB2_UART_BRIDGE_ENABLE
        default 115200
        range 9600 921600

    config PB2_UART_PREVIEW_TARGET_HZ
        int "Target preview stream rate per channel (Hz)"
        depends on PB2_UART_BRIDGE_ENABLE
        default 125
        range 25 250

endmenu
```

## components/recording_gate/Kconfig
```kconfig
menu "Recording gate"

config RECORDING_GATE_REQUIRE_REMOTES_AND_LEVELING
	bool "Require three leveled remote geophones before recording"
	default n
	help
	  When enabled, starting a recording requires at least three assigned
	  REMOTE geophones and accepted leveling from every assigned REMOTE.
	  The default is disabled, so recording may start while these conditions
	  are missing; the status and session metadata still report the conditions.

endmenu
```

## components/seismic_buffer/Kconfig
```kconfig
menu "Seismic buffer"

config SEISMIC_BUFFER_SECONDS
    int "Seismic history duration (seconds)"
    range 1 60
    default 2
    help
        Retain at least this much recent acquisition history when the PSRAM
        budget permits. The ring always contains at least 2,048 frames.

config SEISMIC_BUFFER_PSRAM_BUDGET_BYTES
    int "Seismic buffer PSRAM budget (bytes)"
    range 73728 8388608
    default 2097152
    help
        Maximum PSRAM reserved for the realtime seismic ring, including each
        frame's 44-byte slot (frame plus indexes and publication sequence).
        At 20 kHz the 2-second default uses about 1.76 MiB. At 40 kHz the
        2 MiB cap retains 47,662 frames, about 1.19 seconds; this is acceptable
        because the recorder drains the ring every 500 ms.

endmenu
```

## components/seismic_recorder/Kconfig
```kconfig
choice GEOLOCATOR_GEOMETRY_Z_POLICY
    prompt "Recorded sensor geometry Z policy"
    default GEOLOCATOR_GEOMETRY_Z_POLICY_PLANAR

config GEOLOCATOR_GEOMETRY_Z_POLICY_PLANAR
    bool "Planar"

config GEOLOCATOR_GEOMETRY_Z_POLICY_BAROMETRIC_RELATIVE
    bool "Barometric relative"

endchoice
```
