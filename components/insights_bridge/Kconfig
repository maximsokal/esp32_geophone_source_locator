## main/Kconfig.projbuild
```kconfig
menu "Seismic Acquisition"

    choice SEISMIC_ACQUISITION_SOURCE
        prompt "Acquisition source"
        default SEISMIC_SOURCE_AD7606

        config SEISMIC_SOURCE_TEST
            bool "Synthetic test waveform"

        config SEISMIC_SOURCE_AD7606
            bool "AD7606 SPI acquisition"
            select PCNT_ISR_IRAM_SAFE
    endchoice

    # ESP-IDF 5.5 resolves component dependencies before sdkconfig is
    # available, so all backend components are part of the build graph.
    # Their private configuration constants therefore have to exist for
    # every source selection even when the corresponding backend is not
    # linked into the final application. The prompts are only visible for
    # the selected backend, but the symbols always keep a valid default.

    choice SEISMIC_AD7606_RATE
        prompt "AD7606 acquisition sample rate" if SEISMIC_SOURCE_AD7606
        default SEISMIC_AD7606_RATE_500

        config SEISMIC_AD7606_RATE_500
            bool "500 Hz"

        config SEISMIC_AD7606_RATE_5000
            bool "5 kHz"

        config SEISMIC_AD7606_RATE_10000
            bool "10 kHz"

        config SEISMIC_AD7606_RATE_20000
            bool "20 kHz"

        config SEISMIC_AD7606_RATE_40000
            bool "40 kHz"
    endchoice

    # Preserve the numeric API consumed by backend metadata and buffers.
    config SEISMIC_AD7606_SAMPLE_RATE_HZ
        int
        default 500 if SEISMIC_AD7606_RATE_500
        default 5000 if SEISMIC_AD7606_RATE_5000
        default 10000 if SEISMIC_AD7606_RATE_10000
        default 20000 if SEISMIC_AD7606_RATE_20000
        default 40000 if SEISMIC_AD7606_RATE_40000
        default 500

    choice AD7606_OS_RATIO
        prompt "AD7606 oversampling jumper setting (must match OS0-2 jumpers)" if SEISMIC_SOURCE_AD7606
        default AD7606_OS_RATIO_1
        help
            The firmware measures the startup BUSY pulse and reports the
            configured and measured ratios. The default OS x1 matches the
            shipped 000 jumpers. For OS x4, set the physical jumpers to 010
            and select OS x4 here; do not use 40 kSPS HIL until the measured
            ratio matches this setting.

        config AD7606_OS_RATIO_1
            bool "1"

        config AD7606_OS_RATIO_2
            bool "2"

        config AD7606_OS_RATIO_4
            bool "4"

        config AD7606_OS_RATIO_8
            bool "8"
    endchoice

    config AD7606_OVERSAMPLING_RATIO
        int
        default 1 if AD7606_OS_RATIO_1
        default 2 if AD7606_OS_RATIO_2
        default 4 if AD7606_OS_RATIO_4
        default 8 if AD7606_OS_RATIO_8
        default 1

    config AD7606_SPI_CLOCK_HZ
        int
        prompt "AD7606 SPI clock (Hz)" if SEISMIC_SOURCE_AD7606
        range 1000000 15000000
        default 10000000
        help
            The original AD7606 at VDRIVE 3.3 V is specified for serial SCLK
            up to 15 MHz. The default is 10 MHz; the firmware warns if the
            selected clock exceeds the ESP32-S3 SPI frequency limit.

    choice AD7606_READ_MODE
        prompt "AD7606 serial read timing" if SEISMIC_SOURCE_AD7606
        default AD7606_READ_MODE_AUTO

        config AD7606_READ_MODE_AUTO
            bool "Automatic (after conversion when valid, otherwise during)"

        config AD7606_READ_MODE_AFTER_CONVERSION
            bool "After conversion"

        config AD7606_READ_MODE_DURING_CONVERSION
            bool "During conversion (read previous result)"
    endchoice

    config SEISMIC_AD7606_RAIL_INTERLOCK
        bool
        prompt "AD7606 +5 V rail interlock via INA3221 CH3" if SEISMIC_SOURCE_AD7606
        default y
        help
            MAX-242 firmware layer on top of the LD1117V33 VIO hardware fix.
            Before starting, a fresh INA3221 CH3 reading of the AD7606 +5 V
            rail below 4.75 V refuses the start without driving any AD7606
            pin; while running, two consecutive fresh readings below 4.50 V
            stop acquisition, release every AD7606 pin to Hi-Z and latch a
            power fault. Missing or stale INA3221 data only warns.
            Disable ONLY if the AD7606 +5 V supply is not routed through
            INA3221 channel 3 (otherwise the interlock would see 0 V and
            refuse every start).

    config SEISMIC_RECORDER_PSRAM_CACHE_KB
        int "Recorder PSRAM write-behind cache (KiB)"
        range 256 4096
        default 1024
        help
            Reserve a bounded typed circular cache in external PSRAM between
            the realtime acquisition ring and microSD persistence.  The
            default 1024 KiB is intentionally conservative on the N16R8 board:
            it leaves substantial PSRAM headroom for HTTPS/WebUI and other
            runtime users instead of consuming all external RAM before Wi-Fi
            starts.  At the current 500 Hz / 4-channel frame format this is
            roughly one minute of resident recorder history.  Physical HIL
            heap/high-water telemetry must justify any increase.

config LOCALIZATION_MAX_ANALYSIS_S
        int "Maximum localization analysis duration (seconds)"
        range 1 3600
        default 10
        help
            Analyze at most this many seconds from the start of a recording,
            further bounded by the localization analysis PSRAM budget.

    # MAX-299 8 MiB PSRAM budget estimates (KiB). Static EXT_RAM_BSS is 25 KiB
    # from the linked firmware map. Dynamic rows: 44 B ring slot; recorder
    # cache + batch/index + LOD scratch; localization frame + four channel
    # arrays at 40 B/frame; fixed 24 KiB UI chunk; quality flags;
    # web live-waveform scratch; service stacks; historical staging; web scan and
    # client-log buffers. Per-rate consumers:
    # Rate   static ring  recorder loc arrays UI flags web-wave service hist webIO
    # 500 Hz     25   88      1044       195  24     1       24      75   24    8
    # 20 kHz     25 1719      1044      3072  24    20       24      75   24    8
    # 40 kHz     25 2048      1044      3072  24    40       24      75   24    8
    # On-demand peaks: scan preview up to 2458 KiB occupancy fallback + 57 KiB
    # canvas; localization occupancy file + expanded keys up to 2386 KiB.
    # Localization keeps a 3072 KiB largest-free-block reserve for that input,
    # its workspace and allocation margin. Other live bounded workflow/status
    # allocations reduce the measured free block before the cap is computed.
    # WebUI PSRAM asset caching is disabled in the default sdkconfig.
    # Conservative path totals include recorder retention after stop and the
    # maximum scan preview during acquisition. Localization runs after stop
    # frees the ring; its reserved block is counted as occupied for headroom.
    # Rate     acquisition+scan  headroom  localization  headroom  peak  headroom
    # 500 Hz             3828      4364          4467      3725   4467      3725
    # 20 kHz             5478      2714          7344       848   7344       848
    # 40 kHz             5827      2365          7344       848   7344       848
    # Peak remains the localization path at each rate; its table values are unchanged.
    # Bounded workflow/status/object/web allocations reduce the measured free
    # block before localization chooses its window; scan and localization are
    # on-demand paths. These are allocation estimates, not physical HIL data.

    config LOCALIZATION_ANALYSIS_PSRAM_BUDGET_KB
        int "Localization analysis PSRAM budget (KiB)"
        range 1200 8192
        default 3072
        help
            Bounds the raw frame array and per-channel work arrays together.
            At runtime the window is further limited by the largest free
            PSRAM block minus a 3 MiB reserve for session scan occupancy
            parsing (up to a 1 MiB file plus 1.33 MiB expanded keys), workspace,
            and allocator margin. Localization requires
            at least one second of samples; otherwise it records
            insufficient_memory and fails with an INTERNAL calculation class.

endmenu

menu "Status indicator"

config APP_STATUS_INDICATOR_ENABLED
    bool "Enable physical status LED backend"
    default y
    help
        Drive the main-enclosure GPIO4 red, GPIO5 yellow and GPIO6 green LEDs
        using the official led_indicator GPIO backend. Outputs assume active
        high wiring; physical polarity and operation still require verification.

endmenu

menu "Application display"

config APP_DISPLAY_ENABLED
    bool "Enable TFT/LVGL display"
    default y
    help
        Keep enabled for normal hardware operation. The TFT/LVGL path is not
        modelled and remains unverified in the emulator.

endmenu

menu "Application input"

config APP_KEYPAD_ENABLED
    bool "Enable analog keypad input"
    default y
    help
        Keep enabled for normal hardware operation. Disable only in emulator
        profiles that do not model ADC1 conversion completion.

endmenu

menu "ESP Insights"

config APP_ESP_INSIGHTS
    bool "Enable optional ESP Insights bridge"
    default n
    select ESP_INSIGHTS_ENABLED
    help
        Keep disabled in the baseline firmware. Enabling requires a private
        auth-key provider or an explicitly configured non-HTTPS transport.
        Only selected runtime health metrics are bridged; Wi-Fi credentials,
        sessions, TLS key material, and personal data are never exported by
        this application component.

endmenu

menu "TFT diagnostics"

config UI_MEASUREMENTS_GRAPHS_ENABLED
    bool "Render live measurement graphs"
    default y
    help
        Keep acquisition and SD recording enabled while temporarily disabling
        live TFT graph objects for a CPU/storage arbitration A/B test.

endmenu

menu "HIL timing diagnostics"

config APP_KEYPAD_TIMING_DIAGNOSTICS
    bool "Measure keypad ADC and ESP_TIMER_TASK timing"
    default n
    help
        Enable only for the dedicated keypad timing HIL profile. The profile
        adds a bounded ADC duration histogram and a 10 ms ESP_TIMER_TASK
        dispatch-lateness probe. It is not enabled in the production
        defaults because the probe and its logging change the measured load.

endmenu

menu "I2C bus"

config APP_SENSOR_I2C_SPEED_HZ
    int "Shared sensor/nRF I2C bus clock (Hz)"
    range 10000 400000
    default 100000
    help
        Clock of the ESP32 I2C master on the shared bus (INA3221, barometer,
        TCA9548A and the nRF nodes). Keep 100000: at 25000 the nRF target stopped
        driving its STATUS reply after a few bytes and no node was ever assigned
        (2026-10-27 capture v4). A lower clock lengthens every transfer, so a
        136 byte nRF snapshot takes about four times as long at 25000; the nRF log
        collector budgets scale with it.

endmenu

menu "I2C probe diagnostics"

config APP_I2C_PROBE_DIAGNOSTICS
    bool "Log bounded TCA9548A and nRF upstream I2C diagnostics"
    default y
    help
        Record transaction results, elapsed time, bus line levels, and bounded
        per-route summaries for TCA9548A and nRF upstream I2C traffic.

config APP_I2C_PROBE_DIAGNOSTICS_FULL_PASSES
    int "Number of initial topology passes with full transaction logs"
    range 0 64
    default 3
    depends on APP_I2C_PROBE_DIAGNOSTICS
    help
        Print every captured transaction for this many nRF topology reconcile
        passes. Later passes print when results change or a 60 second summary
        becomes due.

endmenu

menu "WebUI delivery"

config WEB_SERVER_WEBUI_PSRAM_CACHE
    bool "Cache embedded gzip WebUI assets in PSRAM"
    default n
    help
        Copy the immutable embedded gzip WebUI assets to PSRAM at HTTPS
        startup. Requests use the PSRAM copy when the allocation succeeds and
        transparently fall back to the embedded flash assets otherwise.

endmenu

menu "Battery states and low-battery shutdown"

    comment "MAX-180/183: battery SOURCE voltage, uncalibrated 1S defaults -- measure under load (MAX-184)"

    config POWER_BATTERY_LOW_ENTER_MV
        int "BATTERY_LOW below, mV"
        range 2800 4200
        default 3450

    config POWER_BATTERY_LOW_EXIT_MV
        int "BATTERY_LOW clears above, mV"
        range 2800 4200
        default 3600

    config POWER_BATTERY_CRITICAL_ENTER_MV
        int "BATTERY_CRITICAL below, mV"
        range 2800 4200
        default 3300

    config POWER_BATTERY_CRITICAL_EXIT_MV
        int "BATTERY_CRITICAL clears above, mV"
        range 2800 4200
        default 3450

    config POWER_BATTERY_FULL_MV
        int "USB battery reported full at/above, mV"
        range 3800 4350
        default 4100

    config POWER_BATTERY_FULL_EXIT_MV
        int "USB battery full state clears at/below, mV"
        range 3800 4350
        default 4050

    config POWER_BATTERY_CAPACITY_MAH
        int "Usable pack capacity for coulomb counting, mAh (0 = unknown)"
        range 0 20000
        default 0
        help
            MAX-181. Leave 0 until the pack topology (1S2P vs 2S) and the
            usable capacity are measured (MAX-184): with 0 the battery
            percentage stays a labelled voltage-only estimate
            (battery_soc_source = VOLTAGE_ONLY) instead of pretending to
            count coulombs against a guessed capacity.

    config POWER_LOW_BATTERY_GRACE_S
        int "Seconds to plug in USB before the low-battery shutdown"
        range 0 120
        default 10
        help
            After BATTERY_CRITICAL is confirmed (5 samples), the TFT and
            WebUI show a countdown. Stable USB power within this time
            cancels the shutdown; after it the safe shutdown (recorder
            finalised, SD flushed, OFF pulse) starts and is not cancelled.
            The UPS cutoff must come later than CRITICAL + grace + shutdown.

endmenu

menu "INA3221 over-current limits"

    comment "MAX-245: engineering estimates, not measured -- calibrate on the bench"

    config INA3221_BATTERY_WARNING_MA
        int "Battery (CH1) warning current, mA"
        range 50 1600
        default 1200

    config INA3221_BATTERY_CRITICAL_MA
        int "Battery (CH1) critical current, mA"
        range 50 1630
        default 1500

    config INA3221_ESP32_WARNING_MA
        int "ESP32 5 V rail (CH2) warning current, mA"
        range 50 1600
        default 800

    config INA3221_ESP32_CRITICAL_MA
        int "ESP32 5 V rail (CH2) critical current, mA"
        range 50 1630
        default 1200

    config INA3221_AD7606_WARNING_MA
        int "AD7606 5 V rail (CH3) warning current, mA"
        range 10 1600
        default 150

    config INA3221_AD7606_CRITICAL_MA
        int "AD7606 5 V rail (CH3) critical current, mA"
        range 10 1630
        default 250
        help
            Two consecutive samples at or above this current latch a critical
            over-current on the AD7606 rail: acquisition stops and every
            AD7606 pin is released to Hi-Z (MAX-242 interlock). The latch is
            cleared by the next explicit acquisition start.

endmenu

menu "Test-only emulator watchdog"

    config APP_TEST_STARTUP_HEAP_PRESSURE
        bool "Exercise nRF startup under internal heap pressure (TEST ONLY)"
        default n
        depends on !APP_DISPLAY_ENABLED && !APP_KEYPAD_ENABLED && SEISMIC_SOURCE_TEST
        help
            TEST ONLY. Holds internal heap allocations during nRF service
            startup. Use only with the emulator profile; never on hardware.

    config APP_TEST_RECORDING_SCENARIO
        bool "Emulator: record a synthetic geophone signal end to end (TEST ONLY)"
        default n
        depends on !APP_DISPLAY_ENABLED && !APP_KEYPAD_ENABLED && SEISMIC_SOURCE_TEST
        help
            TEST ONLY. Mounts a FAT volume on the "storage_test" flash
            partition in place of the SD card, seeds a confirmed 3-remote
            setup in the nRF topology service and drives the real
            measurement_service START -> record -> STOP path with the
            synthetic seismic source, so stack and heap use of the recording
            path can be measured in ESP-EMU. Never enable for hardware.

    config APP_TEST_WDT_TRIGGER
        bool "Trigger interrupt watchdog once (TEST ONLY)"
        default n
        help
            TEST ONLY. Deliberately hangs the CPU once to exercise
            interrupt-watchdog recovery in the emulator. NEVER enable for
            hardware.

    config APP_TEST_WDT_DELAY_S
        int "Delay before triggering the interrupt watchdog (seconds)"
        range 5 600
        default 25
        depends on APP_TEST_WDT_TRIGGER

endmenu
```
