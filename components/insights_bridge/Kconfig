## nRF54L15/zephyr/Kconfig
```kconfig
source "Kconfig.zephyr"

menu "Application options"

config APP_LOG_TEST_EVENTS
	bool "Generate nRF log test-event bursts"
	default n
	help
	  Emit bounded LOG_TEST_EVENT bursts from the main loop for HIL ring-flood
	  and transport checks. Leave disabled in production images.

config APP_LED_BOOT_LAMP_TEST
	bool "Run the boot LED lamp test"
	default y
	help
	  Drive the external BLUE, GREEN, YELLOW, and RED LEDs briefly at boot.

config APP_NRF_STATUS_PRINT_PERIOD_MS
	int "nRF console status period in milliseconds"
	range 0 3600000
	default 5000
	help
	  Print one bounded runtime status line from the main loop. Set to zero to disable.

config APP_NRF_VERBOSE_LOG
	bool "Print nRF runtime diagnostics"
	default y
	help
	  Print upstream transaction records, state transitions, and periodic status.

config APP_NRF_RADIO_ON_DEMAND
	bool "Radio activity only during an autonomous ranging cycle"
	default y
	help
	  Advertise, scan and connect only while the ESP32 has started an autonomous
	  Channel Sounding cycle (CS_CYCLE_GO) and the cycle is running. Outside it the
	  Bluetooth stack is up but the radio is silent, so it cannot disturb the I2C
	  target during node discovery, calibration and recording. Per-step Channel
	  Sounding commands (CS_EXECUTE) need the radio and fail with a transport error
	  unless this is disabled; disable it for the CS accuracy HIL image.

config APP_NRF_STAGE_SIGNALS
	bool "Show lifecycle stage signals on the logger LEDs"
	default y
	help
	  Briefly overlay lifecycle progress and upstream-loss signals on the logger LEDs.

config APP_NRF_UPSTREAM_LOSS_TIMEOUT_MS
	int "Upstream loss signal timeout in milliseconds"
	depends on APP_NRF_STAGE_SIGNALS
	range 3000 120000
	default 15000
	help
	  ESP32 topology reconcile runs every 5 s, so the timeout must be >= 3x that;
	  the log collector polls every 1 s.

endmenu
```

## tests/target/hardware_self_test/sdkconfig.defaults
```kconfig
CONFIG_ESPTOOLPY_FLASHSIZE_16MB=y
CONFIG_ESPTOOLPY_FLASHSIZE="16MB"
CONFIG_ESPTOOLPY_FLASHMODE_DIO=y
CONFIG_ESPTOOLPY_FLASHFREQ_80M=y

CONFIG_PARTITION_TABLE_CUSTOM=y
CONFIG_PARTITION_TABLE_CUSTOM_FILENAME="partitions.csv"
CONFIG_PARTITION_TABLE_OFFSET=0x8000

CONFIG_SPIRAM=y
CONFIG_SPIRAM_MODE_OCT=y
CONFIG_SPIRAM_TYPE_AUTO=y
CONFIG_SPIRAM_SPEED_80M=y
# CONFIG_SPIRAM_SPEED_40M is not set
CONFIG_SPIRAM_BOOT_HW_INIT=y
CONFIG_SPIRAM_BOOT_INIT=y
CONFIG_SPIRAM_USE_MALLOC=y
CONFIG_SPIRAM_MEMTEST=y
CONFIG_SPIRAM_MALLOC_ALWAYSINTERNAL=2048
CONFIG_SPIRAM_MALLOC_RESERVE_INTERNAL=65536
CONFIG_SPIRAM_ALLOW_BSS_SEG_EXTERNAL_MEMORY=y
CONFIG_FREERTOS_TASK_CREATE_ALLOW_EXT_MEM=y

CONFIG_ESP_PHY_REDUCE_TX_POWER=y
CONFIG_ESP_PHY_MAX_TX_POWER=10
# CONFIG_ESP_PHY_ENABLE_USB is not set
CONFIG_ESP_PHY_RF_CAL_PARTIAL=y

CONFIG_LOG_DEFAULT_LEVEL_INFO=y
CONFIG_ESP_CONSOLE_UART_DEFAULT=y
CONFIG_ESP_CONSOLE_UART_BAUDRATE=115200
```

## tests/target/nrf_cs_accuracy_hil/sdkconfig.defaults
```kconfig
CONFIG_FREERTOS_HZ=1000
CONFIG_LOG_DEFAULT_LEVEL_INFO=y
CONFIG_FATFS_LFN_HEAP=y
CONFIG_FATFS_MAX_LFN=255
CONFIG_FATFS_FS_LOCK=7
```

## tests/target/stress_app/sdkconfig.defaults
```kconfig
CONFIG_ESP_TIMER_SUPPORTS_ISR_DISPATCH_METHOD=y
CONFIG_ESPTOOLPY_FLASHSIZE_16MB=y
CONFIG_ESPTOOLPY_FLASHSIZE="16MB"
CONFIG_SPIRAM=y
CONFIG_SPIRAM_MODE_OCT=y
CONFIG_SPIRAM_TYPE_AUTO=y
CONFIG_SPIRAM_CLK_IO=30
CONFIG_SPIRAM_CS_IO=26
CONFIG_SPIRAM_SPEED_80M=y
# CONFIG_SPIRAM_SPEED_40M is not set
CONFIG_SPIRAM_SPEED=80
CONFIG_SPIRAM_BOOT_HW_INIT=y
CONFIG_SPIRAM_BOOT_INIT=y
CONFIG_SPIRAM_PRE_CONFIGURE_MEMORY_PROTECTION=y
CONFIG_SPIRAM_USE_MALLOC=y
CONFIG_SPIRAM_MEMTEST=y
CONFIG_SPIRAM_MALLOC_ALWAYSINTERNAL=2048
CONFIG_SPIRAM_MALLOC_RESERVE_INTERNAL=65536
CONFIG_SPIRAM_ALLOW_BSS_SEG_EXTERNAL_MEMORY=y
CONFIG_FREERTOS_TASK_CREATE_ALLOW_EXT_MEM=y
CONFIG_FATFS_LFN_HEAP=y
CONFIG_FATFS_MAX_LFN=255
# CONFIG_FATFS_ALLOC_PREFER_EXTRAM is not set
```
